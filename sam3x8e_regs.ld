SECTIONS
{
  Usart0 = 0x40098000;
  Usart1 = 0x4009c000;
  Usart2 = 0x400a0000;
  Usart3 = 0x400a4000;
  Uart0 = 0x400e0800;
  Pmc = 0x400e0600;
  Effc0 = 0x400e0a00;
  Effc1 = 0x400e0c00;
  PioA = 0x400e0e00;
  PioB = 0x400e1000;
  PioC = 0x400e1200;
  PioD = 0x400e1400;
  Rtsc = 0x400e1a00;
  Supc = 0x400e1a10;
  Rtt = 0x400e1a30;
  Wdt = 0x400e1a50;
  Rtc = 0x400e1a60;
  Gpbr = 0x400e1a90;
  Scb = 0xe000e000;
  SysTick = 0xe000e010;
  Nvic = 0xe000e100;
}
